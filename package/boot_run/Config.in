## package/boot_run/Config.in
```kconfig
config BR2_PACKAGE_BOOT_RUN
	bool "loongson buildroot system autorun script after boot"
	depends on BR2_INIT_SYSTEMD || BR2_INIT_BUSYBOX
	help
		this will create a service which name is boot_run.service
		and create a script in /root which name is boot_run.sh
		so this service will run this script after system boot
		just like /etc/profile
		if you don't need it you can run this command
		'systemctl disable boot_run'
		if you want to enable this service you can run this command
		'systemctl enable boot_run'
```

## package/libxkbcommon_rules/Config.in
```kconfig
config BR2_PACKAGE_LIBXKBCOMMON_RULES
	bool "libxkbcommon rules"
	depends on BR2_PACKAGE_LIBXKBCOMMON
	default y
	help
	  xkbcommon is a keymap compiler and support library which
	  processes a reduced subset of keymaps as defined by the XKB
	  specification.

	  and if you want to use xkb successfully
	  you should add xkb rules in /etc/(not only this path but default install in here)

	  http://xkbcommon.org/
```

## package/ls2_sys_config_tool/Config.in
```kconfig
config BR2_PACKAGE_LS2_SYS_CONFIG_TOOL
	bool "ls2k(embedded system) sys config tool"
	default y
	help
		this is a sofeware for loongson-gd embedded board(just like ls2k)
		help user to setup board
		can update uboot kernel rootfs
```

## package/ls_default_eth_config/Config.in
```kconfig
config BR2_PACKAGE_LS_DEFAULT_ETH_CONFIG
	bool "loongson default config eth dev"
	depends on BR2_PACKAGE_NETWORK_MANAGER || BR2_PACKAGE_IFUPDOWN_SCRIPTS
	default n
	help
		if want to set deafult eth dev ip
		can select this option
		and custom BR2_PACKAGE_LS_DEFAULT_ETH_NAME and BR2_PACKAGE_LS_DEFAULT_ETH_IP value
if BR2_PACKAGE_LS_DEFAULT_ETH_CONFIG

config BR2_PACKAGE_LS_DEFAULT_ETH_NAME
	string "eth dev name list"
	depends on BR2_PACKAGE_LS_DEFAULT_ETH_CONFIG
	default "eth0"
	help
		this work by BR2_PACKAGE_LS_DEFAULT_ETH_IP
		just set up board default eth dev ip after system boot
		e.g.
		default value
		will let board eth0 dev ip set to be 192.168.10 after boot
		if use NetworkManger to set
		you can use nmtui to change this defconfig
		if use Network (ifupdown scripts package)
		you can change /etc/network/interfaces file
		if you want to set two or more dev ip
		you can set this value like
		eth0 eht1

config BR2_PACKAGE_LS_DEFAULT_ETH_IP
	string "eth dev ip list"
	depends on BR2_PACKAGE_LS_DEFAULT_ETH_CONFIG
	default "192.168.1.10"
	help
		this work by BR2_PACKAGE_LS_DEFAULT_ETH_NAME
		just set up board default eth dev ip after system boot
		e.g.
		default value
		will let board eth0 dev ip set to be 192.168.10 after boot
		if use NetworkManger to set
		you can use nmtui to change this defconfig
		if use Network (ifupdown scripts package)
		you can change /etc/network/interfaces file
		if you want to set two or more dev ip
		you can set this value like
		192.168.1.10 192.168.2.11

endif
```

## package/qt_movie/Config.in
```kconfig
config BR2_PACKAGE_QT_MOVIE
	bool "qt movie demo"
	default y
	depends on BR2_PACKAGE_QT5
	depends on BR2_PACKAGE_QT5BASE
	help
		change by LSGD
		Qt movie demo
		will auto play run path logo.gif
		install in /root/logo_player/
		name is logo_player

config BR2_PACKAGE_QT_MOVIE_AUTOBOOT
	bool "qt movie auto run agter boot"
	default y
	depends on BR2_PACKAGE_QT_MOVIE
	help
		auto run logo_player after boot
		to show LSGD logo.gif
```

## package/qt_use_tslib/Config.in
```kconfig
config BR2_PACKAGE_QT_USE_TSLIB
	bool "Qt version use tslib"
	depends on BR2_PACKAGE_QT5
	depends on BR2_PACKAGE_QT5BASE
	default n
	help
		if your Qt version need use tslib enable otherwise disable it.
		if usb tslib should export QT_QPA_FB_TSLIB=1 so that tslib run better
```

## package/qtperf/Config.in
```kconfig
config BR2_PACKAGE_QTPERF
	bool "qtperf"
	default y
	depends on BR2_PACKAGE_QT5
	depends on BR2_PACKAGE_QT5BASE
	help
		if your system contain qtperf testcase
		it will build qtperf
```

## package/sourcehanserif/Config.in
```kconfig
config BR2_PACKAGE_SOURCEHANSERIF
	bool "source han serif"
	help
	  "SiYuanSongTi" is a Song-Ti Style (sans-serif) Chinese fonts

config BR2_PACKAGE_SOURCEHANSERIF_CN_REGULAR
	bool "source han serif CN regular"
	depends on BR2_PACKAGE_SOURCEHANSERIF
	help
          select CN regular version SiYuanSongTi
	  file size 13M

config BR2_PACKAGE_SOURCEHANSERIF_CN_REGULAR_SMALL
	bool "source han serif CN regular small version"
	depends on BR2_PACKAGE_SOURCEHANSERIF
	help
	  sub ori file "CN regular"
	  13M -> 2.6M

config BR2_PACKAGE_SOURCEHANSERIF_CN_REGULAR_INSTALL_PATH
	string "install path"
	depends on BR2_PACKAGE_SOURCEHANSERIF
	default "/usr/share/fonts"
	help
	  select install path
	  default is /usr/share/fonts
```

## package/stressapptest/Config.in
```kconfig
config BR2_PACKAGE_STRESSAPPTEST
	bool "stressapptest"
	help
	  Stressful Application Test (or stressapptest, its unix name) is a memory interface test.
	 	It tries to maximize randomized traffic to memory from processor and I/O, with the intent of creating a realistic high load situation in order to test the existing hardware devices in a computer. It has been used at Google for some time and now it is available under the apache 2.0 license.
	 		
	 	  (Exported from code.google.com/p/stressapptest)
	 	
	 	Discussion group: https://groups.google.com/d/forum/stressapptest-discuss
```
