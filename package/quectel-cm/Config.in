## package/quectel-cm/Config.in
```kconfig
config BR2_PACKAGE_QUECTEL_CM
	bool "quectel-cm"
	default n
	help
		Quectel 4G-Model Connection Manager

config BR2_PACKAGE_QUECTEL_CM_LINK
	bool "quectel-cm link to /opt/quectel-cm"
	depends on BR2_PACKAGE_QUECTEL_CM
	default n
```

## package/sherpa-onnx/Config.in
```kconfig
config BR2_PACKAGE_SHERPA_ONNX
	bool "sherpa-onnx Python bindings"
	depends on BR2_PACKAGE_PYTHON3
	depends on BR2_PACKAGE_PYTHON_NUMPY_ARCH_SUPPORTS
	depends on BR2_INSTALL_LIBSTDCPP
	depends on BR2_TOOLCHAIN_HAS_THREADS
	depends on BR2_USE_MMU
	select BR2_PACKAGE_ONNXRUNTIME
	select BR2_PACKAGE_PYTHON_NUMPY
	select BR2_PACKAGE_ALSA_LIB
	help
	  Python bindings for sherpa-onnx.

	  This configuration builds ASR, VAD, keyword spotting,
	  speaker embedding and related speech-processing APIs.
	  TTS, speaker diarization, demo binaries, websocket and
	  PortAudio support are disabled to reduce build size.

	  https://github.com/k2-fsa/sherpa-onnx
```
