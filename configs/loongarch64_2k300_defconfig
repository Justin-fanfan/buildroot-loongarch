## package/ls3_system_tool/Config.in
```kconfig
config BR2_PACKAGE_LS3_SYSTEM_TOOL
	bool "ls3 system tool loongson"
	help
		this is a sofeware or sofeware set work loongson gd board
		help user to test their's board
		if you can't build it because you not build in loongson gd net
		git source unsee in eth
		you can contact oujintao@loongson.cn for help

config BR2_PACKAGE_LS3_SYSTEM_TOOL_QT
	bool "build Qt version"
	depends on BR2_PACKAGE_LS3_SYSTEM_TOOL
	depends on BR2_PACKAGE_QT5
	depends on BR2_PACKAGE_QT5BASE
	help
		if your system contain Qt
		it will build a Qt version test case for you

config BR2_PACKAGE_LS3_SYSTEM_TOOL_QT_AUTO_START
	bool "Qt version auto run after boot"
	depends on BR2_PACKAGE_LS3_SYSTEM_TOOL_QT
	depends on BR2_INIT_SYSTEMD || (BR2_INIT_BUSYBOX && BR2_PACKAGE_BOOT_RUN)
	default n
	help
		if your system contain Qt and select build this software Qt version
		it will set a service which run after boot system to let software exec
```

## package/mdio/Config.in
```kconfig
config BR2_PACKAGE_MDIO
	bool "mdio software"
	default y
	help
		this selection will generate mdio sofeware to /usr/bin
		if selected
		this sofeware ori code just form net
		if found what other package can generate mdio
		you can not select this
```

## package/mp4_sample/Config.in
```kconfig
config BR2_PACKAGE_MP4_SAMPLE
	bool "sample mp4 video"
	depends on BR2_PACKAGE_MPV
	default y
	help
		this selection will copy sample mp4 video to /root/mp4_sample
```

## package/onnxruntime/Config.in
```kconfig
config BR2_PACKAGE_ONNXRUNTIME
	bool "onnxruntime"
	depends on BR2_INSTALL_LIBSTDCPP
	depends on BR2_TOOLCHAIN_HAS_THREADS
	depends on BR2_USE_MMU
	depends on BR2_TOOLCHAIN_GCC_AT_LEAST_9
	help
	  ONNX Runtime CPU inference library.

	  This package is configured for generic LoongArch64 CPUs
	  without LSX or LASX.

	  https://onnxruntime.ai/

if BR2_PACKAGE_ONNXRUNTIME

config BR2_PACKAGE_ONNXRUNTIME_PYTHON
	bool "Python bindings"
	depends on BR2_PACKAGE_PYTHON3
	depends on BR2_PACKAGE_PYTHON_NUMPY_ARCH_SUPPORTS
	depends on BR2_TOOLCHAIN_USES_GLIBC || BR2_TOOLCHAIN_USES_MUSL
	select BR2_PACKAGE_PYTHON_NUMPY
	help
	  Build and install the ONNX Runtime Python bindings so that
	  applications can use the runtime through "import onnxruntime".

endif
```

## package/python-RPi-GPIO-LS/Config.in
```kconfig
config BR2_PACKAGE_PYTHON_RPI_GPIO_LS
	bool "python-RPi.GPIO(LS Ver)"
	help
	  A module to control Raspberry Pi GPIO channels
	  Change by LSGD to support multi board
```

## package/python-gevent-websocket/Config.in
```kconfig
config BR2_PACKAGE_PYTHON_GEVENT_WEBSOCKET
	bool "python-gevent-websocket"
	select BR2_PACKAGE_PYTHON_GEVENT
	help
	  Python binding to the gevent-websocket

	  https://pypi.org/project/gevent-websocket/
```

## package/python-gevent/Config.in
```kconfig
config BR2_PACKAGE_PYTHON_GEVENT
	bool "python-gevent"
	select BR2_PACKAGE_PYTHON_GREENLET
	help
	  Python binding to the gevent

	  https://pypi.org/project/gevent/
```

## package/python-ls-rpi-gpio-demo/Config.in
```kconfig
config BR2_PACKAGE_PYTHON_LS_RPI_GPIO_DEMO
	bool "loongson python demo about RPi.GPIO (LS version)"
	default y
	help
		demo for RPi.GPIO which support by LSGD
```

## package/python-lumacore/Config.in
```kconfig
config BR2_PACKAGE_PYTHON_LUMACORE
	bool "python-luma.core"
	select BR2_PACKAGE_PYTHON_PILLOW # runtime
	select BR2_PACKAGE_PYTHON_SMBUS2 # runtime
	select BR2_PACKAGE_PYTHON_PYFTDI # runtime
	select BR2_PACKAGE_PYTHON_CBOR2 # runtime
	select BR2_PACKAGE_PYTHON_RPI_GPIO_LS # runtime
	select BR2_PACKAGE_PYTHON_SPIDEV # runtime
	help
	  A component library to support SBC display drivers

	  https://pypi.org/project/luma.core
```

## package/python-pyaudio/Config.in
```kconfig
config BR2_PACKAGE_PYTHON_PYAUDIO
	bool "python-pyaudio"
	select BR2_PACKAGE_PORTAUDIO
	help
	  Python binding to the pyaudio

	  https://pypi.org/project/PyAudio/
```

## package/python-pyftdi/Config.in
```kconfig
config BR2_PACKAGE_PYTHON_PYFTDI
	bool "python-pyftdi"
	help
	  FTDI device driver (pure Python)

	  https://pypi.org/project/pyftdi
```

## package/python-sounddevice/Config.in
```kconfig
config BR2_PACKAGE_PYTHON_SOUNDDEVICE
	bool python-sounddevice
	depends on BR2_PACKAGE_PYTHON3
	depends on BR2_PACKAGE_PYTHON_NUMPY_ARCH_SUPPORTS
	select BR2_PACKAGE_PYTHON_CFFI
	select BR2_PACKAGE_PYTHON_NUMPY
	select BR2_PACKAGE_PORTAUDIO
	select BR2_PACKAGE_PORTAUDIO_ALSA
	help
	  Python bindings for PortAudio.

	  https://python-sounddevice.readthedocs.io/
```

## package/python-w1thermsensor/Config.in
```kconfig
config BR2_PACKAGE_PYTHON_W1THERMSENSOR
	bool "python-w1thermsensor"
	help
	  A Python package and CLI tool to work with w1 temperature sensors
	  like DS1822, DS18S20 & DS18B20
	  on the Raspberry Pi, Beagle Bone and other devices.

	  https://pypi.org/project/w1thermsensor
```

## package/qt_music_player/Config.in
```kconfig
config BR2_PACKAGE_QT_MUSIC_PLAYER
	bool "qt music player"
	default y
	depends on BR2_PACKAGE_QT5
	depends on BR2_PACKAGE_QT5BASE
	depends on BR2_PACKAGE_QT5MULTIMEDIA
	help
		https://gitee.com/Singtren/qt-music-player
```

## package/qt_virtual_keyboard_emb/Config.in
```kconfig
config BR2_PACKAGE_QT_VIRTUAL_KEYBOARD_EMB
	bool "qt virtual keyboard for emb linux"
	default y
	depends on BR2_PACKAGE_QT5
	depends on BR2_PACKAGE_QT5BASE
	depends on BR2_PACKAGE_QT5VIRTUALKEYBOARD
	help
	  for emb linux virtual board lib
	  libQt5SoftKeyboardd.so
	  usage:
	  add qputenv("QT_IM_MODULE",QByteArray("Qt5Input")); to main.cpp
```
