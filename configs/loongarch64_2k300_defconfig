## configs/loongarch64_2k300_defconfig
```kconfig
BR2_loongarch=y
BR2_TOOLCHAIN_EXTERNAL=y
BR2_TOOLCHAIN_EXTERNAL_CUSTOM=y
BR2_TOOLCHAIN_EXTERNAL_PATH="/opt/loongarch64-linux-gnu-gcc13.3"
BR2_TOOLCHAIN_EXTERNAL_CUSTOM_PREFIX="$(ARCH)-loongson-linux-gnu"
BR2_TOOLCHAIN_EXTERNAL_GCC_13=y
BR2_TOOLCHAIN_EXTERNAL_HEADERS_6_6=y
BR2_TOOLCHAIN_EXTERNAL_CUSTOM_GLIBC=y
# BR2_TOOLCHAIN_EXTERNAL_INET_RPC is not set
BR2_TOOLCHAIN_EXTERNAL_CXX=y
BR2_PACKAGE_HOST_GDB=y
BR2_PACKAGE_HOST_GDB_TUI=y
BR2_PACKAGE_HOST_GDB_PYTHON3=y
BR2_GDB_VERSION_15=y
BR2_TARGET_LDFLAGS="-Wl,--copy-dt-needed-entries"
BR2_CPAN_MIRROR="https://mirrors.tuna.tsinghua.edu.cn/CPAN"
BR2_SHARED_STATIC_LIBS=y
BR2_TARGET_GENERIC_HOSTNAME="LS-GD"
BR2_TARGET_GENERIC_ISSUE="Welcome to Loongson-gd"
BR2_TARGET_GENERIC_PASSWD_SHA512=y
BR2_INIT_SYSTEMD=y
BR2_TARGET_GENERIC_ROOT_PASSWD="123"
BR2_SYSTEM_BIN_SH_BASH=y
BR2_TARGET_GENERIC_GETTY_PORT="ttyS0"
BR2_TARGET_GENERIC_GETTY_BAUDRATE_115200=y
BR2_SYSTEM_DEFAULT_PATH="/bin:/sbin:/usr/bin:/usr/sbin"
BR2_SYSTEM_ENABLE_NLS=y
BR2_TARGET_LOCALTIME="Asia/Shanghai"
BR2_ROOTFS_OVERLAY="board/loongson/ls2k300/rootfs_overlay"
BR2_ROOTFS_POST_IMAGE_SCRIPT="board/qemu/post-image.sh"
BR2_ROOTFS_POST_SCRIPT_ARGS="$(BR2_DEFCONFIG)"
BR2_PACKAGE_ALSA_UTILS=y
BR2_PACKAGE_ALSA_UTILS_AMIXER=y
BR2_PACKAGE_ALSA_UTILS_APLAY=y
BR2_PACKAGE_FFMPEG_GPL=y
# BR2_PACKAGE_FFMPEG_FFMPEG is not set
BR2_PACKAGE_FFMPEG_FFPLAY=y
BR2_PACKAGE_FFMPEG_ENCODERS=""
BR2_PACKAGE_FFMPEG_DECODERS=""
BR2_PACKAGE_FFMPEG_MUXERS=""
BR2_PACKAGE_FFMPEG_DEMUXERS=""
BR2_PACKAGE_FFMPEG_PARSERS=""
BR2_PACKAGE_FFMPEG_BSFS=""
BR2_PACKAGE_FFMPEG_PROTOCOLS=""
BR2_PACKAGE_FFMPEG_FILTERS=""
# BR2_PACKAGE_FFMPEG_INDEVS is not set
# BR2_PACKAGE_FFMPEG_OUTDEVS is not set
BR2_PACKAGE_MPV=y
BR2_PACKAGE_V4L2GRAB=y
BR2_PACKAGE_GZIP=y
BR2_PACKAGE_UNRAR=y
BR2_PACKAGE_UNZIP=y
BR2_PACKAGE_ZIP=y
BR2_PACKAGE_COREMARK=y
BR2_PACKAGE_DHRYSTONE=y
BR2_PACKAGE_FIO=y
BR2_PACKAGE_GDB=y
BR2_PACKAGE_GDB_SERVER=y
BR2_PACKAGE_GDB_DEBUGGER=y
BR2_PACKAGE_GDB_TUI=y
BR2_PACKAGE_GDB_PYTHON=y
BR2_PACKAGE_IOZONE=y
BR2_PACKAGE_LATENCYTOP=y
BR2_PACKAGE_LMBENCH=y
BR2_PACKAGE_NETPERF=y
BR2_PACKAGE_PV=y
BR2_PACKAGE_RT_TESTS=y
BR2_PACKAGE_STRACE=y
BR2_PACKAGE_STRESS=y
BR2_PACKAGE_STRESS_NG=y
BR2_PACKAGE_STRESSAPPTEST=y
BR2_PACKAGE_DIFFUTILS=y
BR2_PACKAGE_GAWK=y
BR2_PACKAGE_GREP=y
BR2_PACKAGE_SED=y
BR2_PACKAGE_TREE=y
BR2_PACKAGE_DOSFSTOOLS=y
BR2_PACKAGE_DOSFSTOOLS_FATLABEL=y
BR2_PACKAGE_DOSFSTOOLS_FSCK_FAT=y
BR2_PACKAGE_DOSFSTOOLS_MKFS_FAT=y
BR2_PACKAGE_E2FSPROGS=y
BR2_PACKAGE_NFS_UTILS=y
BR2_PACKAGE_NTFS_3G=y
BR2_PACKAGE_SOURCEHANSERIF=y
BR2_PACKAGE_SOURCEHANSERIF_CN_REGULAR=y
BR2_PACKAGE_FSWEBCAM=y
BR2_PACKAGE_FBDUMP=y
BR2_PACKAGE_FBGRAB=y
BR2_PACKAGE_FBSET=y
BR2_PACKAGE_PSPLASH=y
BR2_PACKAGE_SDL2_KMSDRM=y
BR2_PACKAGE_QT5=y
BR2_PACKAGE_QT5BASE_CONCURRENT=y
BR2_PACKAGE_QT5BASE_SQLITE_QT=y
BR2_PACKAGE_QT5BASE_DEFAULT_QPA="linuxfb"
BR2_PACKAGE_QT5BASE_FONTCONFIG=y
BR2_PACKAGE_QT5BASE_HARFBUZZ=y
BR2_PACKAGE_QT5BASE_GIF=y
BR2_PACKAGE_QT5BASE_JPEG=y
BR2_PACKAGE_QT5BASE_PNG=y
BR2_PACKAGE_QT5BASE_DBUS=y
BR2_PACKAGE_QT5BASE_TSLIB=y
BR2_PACKAGE_QT5CHARTS=y
BR2_PACKAGE_QT5MQTT=y
BR2_PACKAGE_QT5MULTIMEDIA=y
BR2_PACKAGE_QT5QUICKCONTROLS=y
BR2_PACKAGE_QT5QUICKCONTROLS2=y
BR2_PACKAGE_QT5QUICKTIMELINE=y
BR2_PACKAGE_QT5SENSORS=y
BR2_PACKAGE_QT5SERIALBUS=y
BR2_PACKAGE_QT5VIRTUALKEYBOARD=y
BR2_PACKAGE_QT5VIRTUALKEYBOARD_HANDWRITING=y
BR2_PACKAGE_QT5VIRTUALKEYBOARD_ARROW_KEY_NAVIGATION=y
BR2_PACKAGE_QT5WEBCHANNEL=y
BR2_PACKAGE_QT5XMLPATTERNS=y
BR2_PACKAGE_DT_UTILS=y
BR2_PACKAGE_HDPARM=y
BR2_PACKAGE_I2C_TOOLS=y
BR2_PACKAGE_LINUX_SERIAL_TEST=y
BR2_PACKAGE_LM_SENSORS=y
BR2_PACKAGE_LM_SENSORS_PWMCONFIG=y
BR2_PACKAGE_LSHW=y
BR2_PACKAGE_MEMTESTER=y
BR2_PACKAGE_RS485CONF=y
BR2_PACKAGE_RTC_TOOLS=y
BR2_PACKAGE_SPI_TOOLS=y
BR2_PACKAGE_SYSSTAT=y
BR2_PACKAGE_USBUTILS=y
BR2_PACKAGE_PYTHON3=y
BR2_PACKAGE_PYTHON3_BZIP2=y
BR2_PACKAGE_PYTHON3_CURSES=y
BR2_PACKAGE_PYTHON3_DECIMAL=y
BR2_PACKAGE_PYTHON3_OSSAUDIODEV=y
BR2_PACKAGE_PYTHON3_READLINE=y
BR2_PACKAGE_PYTHON3_XZ=y
BR2_PACKAGE_PYTHON_DATEUTIL=y
BR2_PACKAGE_PYTHON_FLASK=y
BR2_PACKAGE_PYTHON_MODBUS_TK=y
BR2_PACKAGE_PYTHON_PACKAGING=y
BR2_PACKAGE_PYTHON_PAHO_MQTT=y
BR2_PACKAGE_PYTHON_PIP=y
BR2_PACKAGE_PYTHON_PYMODBUS=y
BR2_PACKAGE_PYTHON_PYMYSQL=y
BR2_PACKAGE_PYTHON_PYQRCODE=y
BR2_PACKAGE_PYTHON_PYTZ=y
BR2_PACKAGE_PYTHON_PYUSB=y
BR2_PACKAGE_PYTHON_SIMPLESQLITE=y
BR2_PACKAGE_PYTHON_SIP=y
BR2_PACKAGE_PYTHON_SOCKETIO=y
BR2_PACKAGE_PYTHON_TYPING_EXTENSIONS=y
BR2_PACKAGE_PYTHON_URLLIB3=y
BR2_PACKAGE_PYTHON_WRAPT=y
BR2_PACKAGE_PYTHON_W1THERMSENSOR=y
BR2_PACKAGE_PYTHON_LUMAOLED=y
BR2_PACKAGE_LIBOPENSSL_BIN=y
BR2_PACKAGE_LIBOPENSSL_ENGINES=y
BR2_PACKAGE_SQLITE_STAT4=y
BR2_PACKAGE_SQLITE_ENABLE_FTS3=y
BR2_PACKAGE_SQLITE_ENABLE_JSON1=y
BR2_PACKAGE_SQLITE_ENABLE_UNLOCK_NOTIFY=y
BR2_PACKAGE_SQLITE_SECURE_DELETE=y
BR2_PACKAGE_SQLITECPP=y
BR2_PACKAGE_JPEG_TURBO=y
BR2_PACKAGE_LIBDRM=y
BR2_PACKAGE_LIBDRM_INSTALL_TESTS=y
BR2_PACKAGE_LIBGPIOD2=y
BR2_PACKAGE_LIBGPIOD2_TOOLS=y
BR2_PACKAGE_LIBXKBCOMMON=y
BR2_PACKAGE_LIBCURL=y
BR2_PACKAGE_LIBCURL_CURL=y
BR2_PACKAGE_LIBCURL_VERBOSE=y
BR2_PACKAGE_LIBCURL_WEBSOCKETS_SUPPORT=y
BR2_PACKAGE_PCRE2_32=y
BR2_PACKAGE_COLLECTD=y
BR2_PACKAGE_COLLECTD_EXEC=y
BR2_PACKAGE_COLLECTD_NFS=y
BR2_PACKAGE_BIND=y
BR2_PACKAGE_BRIDGE_UTILS=y
BR2_PACKAGE_CAN_UTILS=y
BR2_PACKAGE_DHCP=y
BR2_PACKAGE_DHCP_SERVER=y
BR2_PACKAGE_DHCP_SERVER_DELAYED_ACK=y
BR2_PACKAGE_DHCP_RELAY=y
BR2_PACKAGE_DHCP_CLIENT=y
BR2_PACKAGE_ETHTOOL=y
BR2_PACKAGE_HOSTAPD=y
BR2_PACKAGE_IFTOP=y
BR2_PACKAGE_IFUPDOWN=y
BR2_PACKAGE_IPERF3=y
BR2_PACKAGE_IPROUTE2=y
BR2_PACKAGE_IW=y
BR2_PACKAGE_LFTP=y
BR2_PACKAGE_LFTP_CMD_TORRENT=y
BR2_PACKAGE_LFTP_PROTO_FISH=y
BR2_PACKAGE_LFTP_PROTO_HTTP=y
BR2_PACKAGE_LFTP_PROTO_SFTP=y
BR2_PACKAGE_LIGHTTPD=y
BR2_PACKAGE_LIGHTTPD_BZIP2=y
BR2_PACKAGE_LIGHTTPD_OPENSSL=y
# BR2_PACKAGE_LIGHTTPD_PAM is not set
BR2_PACKAGE_LIGHTTPD_PCRE=y
BR2_PACKAGE_LIGHTTPD_WEBDAV=y
BR2_PACKAGE_LIGHTTPD_ZLIB=y
BR2_PACKAGE_LRZSZ=y
BR2_PACKAGE_MJPG_STREAMER=y
BR2_PACKAGE_NETWORK_MANAGER=y
BR2_PACKAGE_NETWORK_MANAGER_TUI=y
BR2_PACKAGE_NETWORK_MANAGER_CLI=y
BR2_PACKAGE_NETWORK_MANAGER_MODEM_MANAGER=y
BR2_PACKAGE_NETWORK_MANAGER_PPPD=y
BR2_PACKAGE_NETWORK_MANAGER_OVS=y
BR2_PACKAGE_OPENSSH=y
BR2_PACKAGE_SSHPASS=y
BR2_PACKAGE_WIRELESS_TOOLS=y
BR2_PACKAGE_WIRELESS_TOOLS_LIB=y
BR2_PACKAGE_WPA_SUPPLICANT=y
BR2_PACKAGE_WPA_SUPPLICANT_WEXT=y
BR2_PACKAGE_WPA_SUPPLICANT_WIRED=y
BR2_PACKAGE_WPA_SUPPLICANT_IBSS_RSN=y
BR2_PACKAGE_WPA_SUPPLICANT_AP_SUPPORT=y
BR2_PACKAGE_WPA_SUPPLICANT_WIFI_DISPLAY=y
BR2_PACKAGE_WPA_SUPPLICANT_MESH_NETWORKING=y
BR2_PACKAGE_WPA_SUPPLICANT_OVERRIDES=y
BR2_PACKAGE_WPA_SUPPLICANT_AUTOSCAN=y
BR2_PACKAGE_WPA_SUPPLICANT_HOTSPOT=y
BR2_PACKAGE_WPA_SUPPLICANT_DEBUG_SYSLOG=y
BR2_PACKAGE_WPA_SUPPLICANT_WPS=y
BR2_PACKAGE_WPA_SUPPLICANT_WPA3=y
BR2_PACKAGE_WPA_SUPPLICANT_CLI=y
BR2_PACKAGE_WPA_SUPPLICANT_WPA_CLIENT_SO=y
BR2_PACKAGE_WPA_SUPPLICANT_PASSPHRASE=y
BR2_PACKAGE_WPA_SUPPLICANT_DBUS=y
BR2_PACKAGE_WPA_SUPPLICANT_DBUS_INTROSPECTION=y
BR2_PACKAGE_FILE=y
BR2_PACKAGE_COREUTILS=y
BR2_PACKAGE_DEBIANUTILS=y
BR2_PACKAGE_HTOP=y
BR2_PACKAGE_PROCPS_NG=y
BR2_PACKAGE_PROCPS_NS_ORIGINAL_TOP=y
BR2_PACKAGE_START_STOP_DAEMON=y
BR2_PACKAGE_SYSTEMD_ANALYZE=y
# BR2_PACKAGE_SYSTEMD_HWDB is not set
BR2_PACKAGE_UTIL_LINUX_BINARIES=y
BR2_PACKAGE_UTIL_LINUX_HWCLOCK=y
BR2_PACKAGE_UTIL_LINUX_KILL=y
BR2_PACKAGE_UTIL_LINUX_LOGIN=y
BR2_PACKAGE_UTIL_LINUX_MORE=y
BR2_PACKAGE_UTIL_LINUX_MOUNTPOINT=y
BR2_PACKAGE_UTIL_LINUX_NOLOGIN=y
BR2_PACKAGE_UTIL_LINUX_PARTX=y
BR2_PACKAGE_UTIL_LINUX_RFKILL=y
BR2_PACKAGE_UTIL_LINUX_SCHEDUTILS=y
BR2_PACKAGE_VIM=y
BR2_PACKAGE_BOOT_RUN=y
# BR2_PACKAGE_QT_MOVIE_AUTOBOOT is not set
BR2_PACKAGE_LS_DEFAULT_ETH_CONFIG=y
BR2_PACKAGE_LS3_SYSTEM_TOOL=y
BR2_PACKAGE_LS3_SYSTEM_TOOL_QT=y
BR2_PACKAGE_LOONGSON_RESIZE=y
BR2_PACKAGE_QT_USE_TSLIB=y
BR2_PACKAGE_QUECTEL_CM=y
BR2_PACKAGE_LOONGSON_KERNEL=y
BR2_PACKAGE_LOONGSON_KERNEL_PATH="~/tmp/bsp/test/2K300/abi2/kernel/"
BR2_TARGET_ROOTFS_EXT2=y
BR2_TARGET_ROOTFS_EXT2_4=y
BR2_TARGET_ROOTFS_EXT2_SIZE="512M"
BR2_TARGET_ROOTFS_EXT2_MKFS_OPTIONS="-O ^64bit -O ^metadata_csum"
BR2_TARGET_ROOTFS_EXT2_PIGZ=y
BR2_TARGET_ROOTFS_TAR_PIGZ=y
BR2_PACKAGE_HOST_KMOD=y
```

## configs/loongarch64_compile_gcc13_defconfig
```kconfig
BR2_loongarch=y
BR2_TOOLCHAIN_BUILDROOT_VENDOR="loongson"
BR2_KERNEL_HEADERS_6_6=y
BR2_BINUTILS_VERSION_2_42_X=y
BR2_TOOLCHAIN_BUILDROOT_CXX=y
BR2_PACKAGE_HOST_GDB=y
BR2_PACKAGE_HOST_GDB_TUI=y
BR2_PACKAGE_HOST_GDB_PYTHON3=y
BR2_GDB_VERSION_15=y
BR2_SHARED_STATIC_LIBS=y
BR2_INIT_NONE=y
# BR2_TARGET_ENABLE_ROOT_LOGIN is not set
BR2_SYSTEM_BIN_SH_NONE=y
# BR2_TARGET_GENERIC_GETTY is not set
# BR2_TARGET_GENERIC_REMOUNT_ROOTFS_RW is not set
# BR2_ENABLE_LOCALE_PURGE is not set
BR2_ROOTFS_POST_IMAGE_SCRIPT="board/qemu/post-image.sh"
BR2_ROOTFS_POST_SCRIPT_ARGS="$(BR2_DEFCONFIG)"
# BR2_PACKAGE_BUSYBOX is not set
# BR2_PACKAGE_IFUPDOWN_SCRIPTS is not set
# BR2_TARGET_ROOTFS_TAR is not set
```

## configs/loongarch64_qt5_host_defconfig
```kconfig
BR2_loongarch=y
BR2_TOOLCHAIN_EXTERNAL=y
BR2_TOOLCHAIN_EXTERNAL_CUSTOM=y
BR2_TOOLCHAIN_EXTERNAL_PATH="/opt/loongarch64-linux-gnu-gcc13.3"
BR2_TOOLCHAIN_EXTERNAL_CUSTOM_PREFIX="$(ARCH)-loongson-linux-gnu"
BR2_TOOLCHAIN_EXTERNAL_GCC_13=y
BR2_TOOLCHAIN_EXTERNAL_HEADERS_6_6=y
BR2_TOOLCHAIN_EXTERNAL_CUSTOM_GLIBC=y
# BR2_TOOLCHAIN_EXTERNAL_INET_RPC is not set
BR2_TOOLCHAIN_EXTERNAL_CXX=y
BR2_TARGET_LDFLAGS="-Wl,--copy-dt-needed-entries"
BR2_CPAN_MIRROR="https://mirrors.tuna.tsinghua.edu.cn/CPAN"
BR2_SHARED_STATIC_LIBS=y
BR2_TARGET_GENERIC_HOSTNAME=""
BR2_TARGET_GENERIC_ISSUE=""
BR2_TARGET_GENERIC_PASSWD_SHA512=y
BR2_INIT_NONE=y
# BR2_TARGET_ENABLE_ROOT_LOGIN is not set
BR2_SYSTEM_BIN_SH_BASH=y
# BR2_TARGET_GENERIC_GETTY is not set
# BR2_TARGET_GENERIC_REMOUNT_ROOTFS_RW is not set
# BR2_ENABLE_LOCALE_PURGE is not set
BR2_ROOTFS_POST_IMAGE_SCRIPT="board/qemu/post-image.sh"
BR2_ROOTFS_POST_SCRIPT_ARGS="$(BR2_DEFCONFIG)"
# BR2_PACKAGE_BUSYBOX is not set
BR2_PACKAGE_QT5=y
BR2_PACKAGE_QT5BASE_CONCURRENT=y
BR2_PACKAGE_QT5BASE_MYSQL=y
BR2_PACKAGE_QT5BASE_SQLITE_QT=y
BR2_PACKAGE_QT5BASE_DEFAULT_QPA="linuxfb"
BR2_PACKAGE_QT5BASE_FONTCONFIG=y
BR2_PACKAGE_QT5BASE_HARFBUZZ=y
BR2_PACKAGE_QT5BASE_GIF=y
BR2_PACKAGE_QT5BASE_JPEG=y
BR2_PACKAGE_QT5BASE_PNG=y
BR2_PACKAGE_QT5BASE_SYSLOG=y
BR2_PACKAGE_QT5BASE_DBUS=y
BR2_PACKAGE_QT5BASE_TSLIB=y
BR2_PACKAGE_QT5CHARTS=y
BR2_PACKAGE_QT5COAP=y
BR2_PACKAGE_QT5DOC=y
BR2_PACKAGE_QT5ENGINIO=y
BR2_PACKAGE_QT5IMAGEFORMATS=y
BR2_PACKAGE_QT5KNX=y
BR2_PACKAGE_QT5LOCATION=y
BR2_PACKAGE_QT5LOTTIE=y
BR2_PACKAGE_QT5MQTT=y
BR2_PACKAGE_QT5MULTIMEDIA=y
BR2_PACKAGE_QT5OPCUA=y
BR2_PACKAGE_QT5QUICKCONTROLS=y
BR2_PACKAGE_QT5QUICKCONTROLS2=y
BR2_PACKAGE_QT5QUICKTIMELINE=y
BR2_PACKAGE_QT5REMOTEOBJECTS=y
BR2_PACKAGE_QT5SCRIPT=y
BR2_PACKAGE_QT5SCXML=y
BR2_PACKAGE_QT5SENSORS=y
BR2_PACKAGE_QT5SERIALBUS=y
BR2_PACKAGE_QT5SPEECH=y
BR2_PACKAGE_QT5VIRTUALKEYBOARD=y
BR2_PACKAGE_QT5VIRTUALKEYBOARD_HANDWRITING=y
BR2_PACKAGE_QT5VIRTUALKEYBOARD_ARROW_KEY_NAVIGATION=y
BR2_PACKAGE_QT5WEBCHANNEL=y
BR2_PACKAGE_QT5XMLPATTERNS=y
BR2_PACKAGE_SQLITE_STAT4=y
BR2_PACKAGE_SQLITE_ENABLE_FTS3=y
BR2_PACKAGE_SQLITE_ENABLE_JSON1=y
BR2_PACKAGE_SQLITE_ENABLE_UNLOCK_NOTIFY=y
BR2_PACKAGE_SQLITE_SECURE_DELETE=y
BR2_PACKAGE_SQLITECPP=y
BR2_PACKAGE_JPEG_TURBO=y
# BR2_PACKAGE_IFUPDOWN_SCRIPTS is not set
# BR2_PACKAGE_MDIO is not set
# BR2_PACKAGE_QTPERF is not set
# BR2_PACKAGE_QT_MOVIE is not set
# BR2_PACKAGE_QT_MUSIC_PLAYER is not set
# BR2_PACKAGE_LS2_SYS_CONFIG_TOOL is not set
# BR2_TARGET_ROOTFS_TAR is not set
```

## configs/loongarch64_ramdisk_defconfig
```kconfig
BR2_loongarch=y
BR2_TOOLCHAIN_EXTERNAL=y
BR2_TOOLCHAIN_EXTERNAL_CUSTOM=y
BR2_TOOLCHAIN_EXTERNAL_PATH="/opt/loongarch64-linux-gnu-gcc13.3"
BR2_TOOLCHAIN_EXTERNAL_CUSTOM_PREFIX="$(ARCH)-loongson-linux-gnu"
BR2_TOOLCHAIN_EXTERNAL_GCC_13=y
BR2_TOOLCHAIN_EXTERNAL_HEADERS_6_6=y
BR2_TOOLCHAIN_EXTERNAL_CUSTOM_GLIBC=y
# BR2_TOOLCHAIN_EXTERNAL_INET_RPC is not set
BR2_TOOLCHAIN_EXTERNAL_CXX=y
BR2_TARGET_LDFLAGS="-Wl,--copy-dt-needed-entries"
BR2_CPAN_MIRROR="https://mirrors.tuna.tsinghua.edu.cn/CPAN"
BR2_SHARED_STATIC_LIBS=y
BR2_TARGET_GENERIC_HOSTNAME="LS-GD"
BR2_TARGET_GENERIC_ISSUE="Welcome to Loongson-gd ramdisk"
BR2_TARGET_GENERIC_PASSWD_SHA512=y
BR2_ROOTFS_MERGED_USR=y
# BR2_TARGET_ENABLE_ROOT_LOGIN is not set
# BR2_TARGET_GENERIC_GETTY is not set
BR2_SYSTEM_DEFAULT_PATH="/bin:/sbin:/usr/bin:/usr/sbin"
# BR2_ENABLE_LOCALE_PURGE is not set
BR2_ROOTFS_OVERLAY="board/loongson/rootfs_ramdisk_overlay/"
BR2_ROOTFS_POST_IMAGE_SCRIPT="board/qemu/post-image.sh"
BR2_ROOTFS_POST_SCRIPT_ARGS="$(BR2_DEFCONFIG)"
BR2_PACKAGE_BUSYBOX_SHOW_OTHERS=y
BR2_PACKAGE_GZIP=y
BR2_PACKAGE_PIGZ=y
BR2_PACKAGE_PV=y
BR2_PACKAGE_CHECK=y
BR2_PACKAGE_E2FSPROGS=y
BR2_PACKAGE_ETHTOOL=y
# BR2_PACKAGE_IFUPDOWN_SCRIPTS is not set
BR2_PACKAGE_IPROUTE2=y
BR2_PACKAGE_RSYNC=y
# BR2_PACKAGE_URANDOM_SCRIPTS is not set
BR2_PACKAGE_BASH=y
BR2_PACKAGE_START_STOP_DAEMON=y
BR2_PACKAGE_UTIL_LINUX_LIBFDISK=y
BR2_PACKAGE_UTIL_LINUX_FSCK=y
BR2_PACKAGE_UTIL_LINUX_LOSETUP=y
BR2_PACKAGE_UTIL_LINUX_MOUNT=y
BR2_PACKAGE_UTIL_LINUX_MOUNTPOINT=y
BR2_PACKAGE_UTIL_LINUX_PARTX=y
# BR2_PACKAGE_LS2_SYS_CONFIG_TOOL is not set
BR2_TARGET_ROOTFS_EXT2=y
BR2_TARGET_ROOTFS_EXT2_SIZE="32M"
BR2_TARGET_ROOTFS_EXT2_PIGZ=y
# BR2_TARGET_ROOTFS_TAR is not set
BR2_PACKAGE_HOST_KMOD=y
BR2_PACKAGE_HOST_MKPASSWD=y
```

## package/loongson_custom_inputrc/Config.in
```kconfig
config BR2_PACKAGE_LOONGSON_CUSTOM_INPUTRC
	bool "use custom inputrc"
	depends on BR2_PACKAGE_READLINE
	default y
	help
	  custom inputrc
	  /etc/inputrc
```

## package/loongson_custom_timesyncd_conf/Config.in
```kconfig
config BR2_PACKAGE_LOONGSON_CUSTOM_TIMESYNCD_CONF
	bool "use custom timesyncd.conf"
	depends on BR2_PACKAGE_SYSTEMD
	default y
	help
	  custom timesyncd.conf
	  /etc/systemd/timesyncd.conf
```

## package/loongson_custom_vimrc/Config.in
```kconfig
config BR2_PACKAGE_LOONGSON_CUSTOM_VIMRC
	bool "use custom vimrc"
	depends on BR2_PACKAGE_VIM
	default y
	help
	  custom vimrc
	  /usr/share/vim/vimrc
```

## package/loongson_kernel/Config.in
```kconfig
config BR2_PACKAGE_LOONGSON_KERNEL
	bool "Loongson Linux Kernel"
	help
	  Enable this option if you want to put a Linux kernel(uImage)
	  in /boot dir

config BR2_PACKAGE_LOONGSON_KERNEL_HOSTSITE
	string "uImage Host site"
	depends on BR2_PACKAGE_LOONGSON_KERNEL
	default ""

config BR2_PACKAGE_LOONGSON_KERNEL_USER
	string "uImage Host User"
	depends on BR2_PACKAGE_LOONGSON_KERNEL
	default ""

config BR2_PACKAGE_LOONGSON_KERNEL_PASSWORD
	string "uImage Host password"
	depends on BR2_PACKAGE_LOONGSON_KERNEL
	default ""

config BR2_PACKAGE_LOONGSON_KERNEL_PATH
	string "uImage file path in host site"
	depends on BR2_PACKAGE_LOONGSON_KERNEL

config BR2_PACKAGE_LOONGSON_KERNEL_MODULES
	bool "Loongson Linux Kernel Modules"
	depends on BR2_PACKAGE_LOONGSON_KERNEL
	default y
	help
	  Enable this option if you want to put kernel objects in /usr/lib/modules
```

## package/loongson_resize/Config.in
```kconfig
config BR2_PACKAGE_LOONGSON_RESIZE
	bool "loongson system resize rootfs"
	depends on BR2_INIT_SYSTEMD || BR2_INIT_BUSYBOX
	select BR2_PACKAGE_PARTED
	select BR2_PACKAGE_E2FSPROGS_RESIZE2FS
	help
		Resize rootfs when first startup, if device parted,
		rootfs should in last part, otherwise cannot resize
		rootfs partition
```

## package/loongson_timesyncd_config/Config.in
```kconfig
config BR2_PACKAGE_LOONGSON_TIMESYNCD_CONFIG
	bool "Run 'timedatectl set-ntp 0' when first boot"
	depends on BR2_PACKAGE_SYSTEMD_TIMESYNCD
	default y
	help
		disable ntp timesync
```
